## renode-zephyr-bootloader/hello_world/west.yml
```yaml
manifest:
  defaults:
    remote: local

  remotes:
    - name: local
      url-base: file:///home/simon/zephyrproject

  projects:
    - name: zephyr
      remote: local
      revision: v4.2.0
      import:
        name-allowlist:
          - mbedtls
          - zcbor
          - hal_nordic
          - cmsis
          - drivers

  self:
    path: project
```
